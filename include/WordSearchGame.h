#pragma once
#include <Arduino.h>
#include <Preferences.h>
#include "Arduboy2.h"
#include "ArduboyTones.h"
#include "hangman_words.h"

extern Arduboy2 arduboy;
extern ArduboyTones sound;

enum SopaState : uint8_t {
    SOPA_STATE_DIFFICULTY = 0,
    SOPA_STATE_PLAYING,
    SOPA_STATE_VICTORY
};

enum SopaDifficulty : uint8_t {
    SOPA_DIFF_FACIL = 0,
    SOPA_DIFF_MEDIO,
    SOPA_DIFF_DIFICIL
};

struct SopaWord {
    char text[10];
    int8_t startC;
    int8_t startR;
    int8_t endC;
    int8_t endR;
    bool found;
};

// -----------------------------------------------------------------------------
// FUENTE RETRO 5x5 PARA LA MATRIZ DE LETRAS (ESPACIADO GRANDE Y SIMÉTRICO)
// -----------------------------------------------------------------------------
static const uint8_t PROGMEM font5x5[26][5] = {
    {0x0E, 0x11, 0x1F, 0x11, 0x11}, // A
    {0x1E, 0x11, 0x1E, 0x11, 0x1E}, // B
    {0x0E, 0x11, 0x10, 0x11, 0x0E}, // C
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    {0x1F, 0x02, 0x04, 0x08, 0x1F}  // Z
};

static inline void drawLetter5x5(int16_t x, int16_t y, char c, uint8_t color) {
    if (c >= 'a' && c <= 'z') c -= 32;
    if (c < 'A' || c > 'Z') return;
    uint8_t idx = c - 'A';
    for (int8_t r = 0; r < 5; r++) {
        uint8_t row = pgm_read_byte(&font5x5[idx][r]);
        for (int8_t b = 0; b < 5; b++) {
            if (row & (1 << (4 - b))) {
                arduboy.drawPixel(x + b, y + r, color);
            }
        }
    }
}

// -----------------------------------------------------------------------------
// FUENTE MICRO-PIXEL 3x5 PARA EL PANEL LATERAL (A-Z, 0-9, SIMBOLOS)
// -----------------------------------------------------------------------------
static const uint8_t PROGMEM miniFont3x5[43][5] = {
    {0x2, 0x5, 0x7, 0x5, 0x5}, // A (0)
    {0x6, 0x5, 0x6, 0x5, 0x6}, // B (1)
    {0x3, 0x4, 0x4, 0x4, 0x3}, // C (2)
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    {0x0, 0x0, 0x0, 0x0, 0x0}  // space (42)
};

static inline int8_t getMiniGlyphIndex(char c) {
    if (c >= 'A' && c <= 'Z') return c - 'A';
    if (c >= 'a' && c <= 'z') return c - 'a';
    if (c >= '0' && c <= '9') return 26 + (c - '0');
    if (c == ':') return 36;
    if (c == '/') return 37;
    if (c == '-') return 38;
    if (c == '[') return 39;
    if (c == ']') return 40;
    if (c == '.') return 41;
    if (c == ' ') return 42;
    return -1;
}

static inline uint8_t getMiniCharWidth(char c) {
    if (c == ':' || c == '.') return 2;
    if (c == ' ') return 2;
    if (c == '[' || c == ']') return 3;
    return 4; // 3px de glifo + 1px de espaciado garantizado para todas las letras A-Z (incluida la 'I') y dígitos
}

static inline void drawMiniChar(int16_t x, int16_t y, char c, uint8_t color = WHITE) {
    int8_t idx = getMiniGlyphIndex(c);
    if (idx < 0 || idx == 42) return;
    for (int8_t r = 0; r < 5; r++) {
        uint8_t row = pgm_read_byte(&miniFont3x5[idx][r]);
        if (row & 0x04) arduboy.drawPixel(x, y + r, color);
        if (row & 0x02) arduboy.drawPixel(x + 1, y + r, color);
        if (row & 0x01) arduboy.drawPixel(x + 2, y + r, color);
    }
}

static inline void drawMiniText(int16_t x, int16_t y, const char* str, uint8_t color = WHITE) {
    int16_t cx = x;
    while (*str) {
        char c = *str++;
        drawMiniChar(cx, y, c, color);
        cx += getMiniCharWidth(c);
    }
}

class WordSearchGame {
public:
    SopaState state;
    SopaDifficulty currentDifficulty;
    uint8_t difficultyCursor;

    bool exitRequested;
    bool gameOver;
    bool victory;

    int8_t cursorCol; // 0..10
    int8_t cursorRow; // 0..5
    bool isSelecting;
    int8_t startCol;
    int8_t startRow;

    char currentGrid[6][14];
    SopaWord activeWords[5];
    uint8_t activeWordCount;
    uint8_t foundCount;

    uint32_t score;
    uint32_t highScore;

    void init();
    void generateRandomPuzzle();
    void update();
    void draw();
    void drawDifficultyScreen();
    void saveHighScore();
    void loadHighScore();

private:
    void drawCornerBrackets(int16_t cx, int16_t cy);
    void drawFoundBox(int8_t sc, int8_t sr, int8_t ec, int8_t er);
    void validateSelection();
    bool isReverseMatch(const char* s1, const char* s2);
};
